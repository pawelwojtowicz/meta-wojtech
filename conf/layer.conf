## conf/layer.conf
```bitbake
# We have a conf and classes directory, add to BBPATH
BBPATH .= ":${LAYERDIR}"

# We have recipes-* directories, add to BBFILES
BBFILES += "${LAYERDIR}/recipes-*/*/*.bb \
            ${LAYERDIR}/recipes-*/*/*.bbappend"

BBFILE_COLLECTIONS += "meta-wojtech"
BBFILE_PATTERN_meta-wojtech = "^${LAYERDIR}/"
BBFILE_PRIORITY_meta-wojtech = "6"

LAYERDEPENDS_meta-wojtech = "core"
LAYERSERIES_COMPAT_meta-wojtech = "honister"
```
